## sdkconfig.defaults
```kconfig
CONFIG_AUTOSTART_ARDUINO=y
CONFIG_FREERTOS_HZ=1000
CONFIG_RTC_CLK_SRC_INT_RC=1
CONFIG_ESP_TLS_USING_MBEDTLS=1
CONFIG_ESP_TLS_SERVER=1
CONFIG_ESP_TLS_USING_CRT_BUNDLE=y
CONFIG_ESP_TLS_PSK_VERIFICATION=y
CONFIG_ESPTOOLPY_FLASHSIZE_8MB=y
CONFIG_PARTITION_TABLE_OFFSET=0xA000
CONFIG_SPIRAM=y
CONFIG_SPIRAM_CACHE_WORKAROUND=y
```
